## yocto-project/meta-app/conf/machine/qemux86-noirda.conf
```bitbake
#@TYPE: Machine
#@NAME: qemux86-cc
#@DESCRIPTION: qemux86 with some modifications

require conf/machine/qemux86.conf

# Drop irda, has some build problems
MACHINE_FEATURES = "apm alsa pcmcia bluetooth usbgadget screen x86"
```
